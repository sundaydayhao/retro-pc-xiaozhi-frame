## components/bsp/Kconfig
```kconfig
menu "Board Support Package (2.8inch ESP32-S3 Display)"

    config BSP_LCD_SPI_CLOCK_HZ
        int "LCD SPI clock frequency (Hz)"
        default 40000000
        range 1000000 80000000
        help
            SPI clock frequency for the ILI9341 LCD panel.
            Maximum is 40 MHz for write operations.

    config BSP_LCD_COLOR_INVERT
        bool "Invert LCD colors"
        default y
        help
            Enable color inversion for the ILI9341 panel.
            Usually required for correct color display.

    config BSP_AUDIO_MCLK_MULTIPLE
        int "I2S MCLK multiple of sample rate"
        default 256
        range 128 512
        help
            MCLK = sample_rate * multiple.
            Set to 256 for most I2S DACs/ADCs.

endmenu
```

## sdkconfig.defaults.esp32s3
```kconfig
# ESP32-S3 specific configuration for 2.8inch ESP32-S3 Display board
# Flash: 16MB QIO, PSRAM: 8MB Octal

CONFIG_ESPTOOLPY_FLASHSIZE_16MB=y
CONFIG_ESPTOOLPY_FLASHMODE_QIO=y

# CPU: 240 MHz
CONFIG_ESP_DEFAULT_CPU_FREQ_MHZ_240=y

# PSRAM (8MB Octal, 80MHz)
CONFIG_SPIRAM=y
CONFIG_SPIRAM_MODE_OCT=y
CONFIG_SPIRAM_SPEED_80M=y
CONFIG_SPIRAM_MALLOC_ALWAYSINTERNAL=65536
CONFIG_LV_DRAW_BUF_ALIGN=64
CONFIG_SPIRAM_MALLOC_RESERVE_INTERNAL=49152
CONFIG_SPIRAM_MEMTEST=n
CONFIG_MBEDTLS_EXTERNAL_MEM_ALLOC=y

# Cache
CONFIG_ESP32S3_INSTRUCTION_CACHE_32KB=y
CONFIG_ESP32S3_DATA_CACHE_64KB=y
CONFIG_ESP32S3_DATA_CACHE_LINE_64B=y

CONFIG_ESP_SYSTEM_EVENT_TASK_STACK_SIZE=4096

# Wake word model: 你好小智
CONFIG_SR_WN_WN9_NIHAOXIAOZHI_TTS=y
```
